# file: RTOS_Queue.ioc
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FREERTOS.Tasks01=defaultTask,0,128,StartDefaultTask,Default
Mcu.Family=STM32F4
Mcu.Name=STM32F407V(E-G)Tx
Mcu.Package=LQFP100
NVIC.EXTI0_IRQn=true\:6\:0\:true\:false\:true
NVIC.PriorityGroup=NVIC_PRIORITYGROUP_4
NVIC.TIM1_UP_TIM10_IRQn=true\:0\:0\:false\:false\:true
NVIC.TimeBase=TIM1_UP_TIM10_IRQn
NVIC.TimeBaseIP=TIM1
PA0-WKUP.Signal=GPXTI0
PA13.Mode=Serial-Wire
PA13.Signal=SYS_JTMS-SWDIO
PA14.Mode=Serial-Wire
PA14.Signal=SYS_JTCK-SWCLK
PH0-OSC_IN.Mode=HSE-External-Oscillator
PH0-OSC_IN.Signal=RCC_OSC_IN
PH1-OSC_OUT.Mode=HSE-External-Oscillator
PH1-OSC_OUT.Signal=RCC_OSC_OUT
ProjectManager.HeapSize=0x200
ProjectManager.StackSize=0x400
ProjectManager.TargetToolchain=MDK-ARM V5
RCC.48MHZClocksFreq_Value=84000000
RCC.AHBFreq_Value=168000000
RCC.APB1CLKDivider=RCC_HCLK_DIV4
RCC.APB1Freq_Value=42000000
RCC.APB1TimCLKDivider=1
RCC.APB1TimFreq_Value=42000000
RCC.APB2CLKDivider=RCC_HCLK_DIV2
RCC.APB2Freq_Value=84000000
RCC.APB2TimCLKDivider=1
RCC.APB2TimFreq_Value=84000000
RCC.CortexFreq_Value=168000000
RCC.HCLKFreq_Value=168000000
RCC.HSE_VALUE=8000000
RCC.HSI_VALUE=16000000
RCC.LSE_VALUE=32768
RCC.PLLM=4
RCC.PLLN=168
RCC.PLLSourceVirtual=RCC_PLLSOURCE_HSE
RCC.SYSCLKFreq_VALUE=168000000
RCC.SYSCLKSource=RCC_SYSCLKSOURCE_PLLCLK
RCC.VCOOutputFreq_Value=336000000
VP_FREERTOS_VS_ENABLE.Mode=Enabled
VP_SYS_VS_tim1.Mode=TIM1
board=RTOS_Queue

// file: Src/main.c
/**
  ******************************************************************************
  * File Name          : main.c
  * Description        : Main program body
  ******************************************************************************
  *
  * COPYRIGHT(c) 2021 STMicroelectronics
  *
  * Redistribution and use in source and binary forms, with or without modification,
  * are permitted provided that the following conditions are met:
  *   1. Redistributions of source code must retain the above copyright notice,
  *      this list of conditions and the following disclaimer.
  *   2. Redistributions in binary form must reproduce the above copyright notice,
  *      this list of conditions and the following disclaimer in the documentation
  *      and/or other materials provided with the distribution.
  *   3. Neither the name of STMicroelectronics nor the names of its contributors
  *      may be used to endorse or promote products derived from this software
  *      without specific prior written permission.
  *
  * THIS SOFTWARE IS PROVIDED BY THE COPYRIGHT HOLDERS AND CONTRIBUTORS "AS IS"
  * AND ANY EXPRESS OR IMPLIED WARRANTIES, INCLUDING, BUT NOT LIMITED TO, THE
  * IMPLIED WARRANTIES OF MERCHANTABILITY AND FITNESS FOR A PARTICULAR PURPOSE ARE
  * DISCLAIMED. IN NO EVENT SHALL THE COPYRIGHT HOLDER OR CONTRIBUTORS BE LIABLE
  * FOR ANY DIRECT, INDIRECT, INCIDENTAL, SPECIAL, EXEMPLARY, OR CONSEQUENTIAL
  * DAMAGES (INCLUDING, BUT NOT LIMITED TO, PROCUREMENT OF SUBSTITUTE GOODS OR
  * SERVICES; LOSS OF USE, DATA, OR PROFITS; OR BUSINESS INTERRUPTION) HOWEVER
  * CAUSED AND ON ANY THEORY OF LIABILITY, WHETHER IN CONTRACT, STRICT LIABILITY,
  * OR TORT (INCLUDING NEGLIGENCE OR OTHERWISE) ARISING IN ANY WAY OUT OF THE USE
  * OF THIS SOFTWARE, EVEN IF ADVISED OF THE POSSIBILITY OF SUCH DAMAGE.
  *
  ******************************************************************************
  */
#include "stm32f4xx_hal.h"
#include "cmsis_os.h"

/* USER CODE BEGIN PV */
/* Private variables ---------------------------------------------------------*/
xQueueHandle Struct_Queue_Handler;	//handler of queue struct
xQueueHandle Simple_Queue_Handler;	//handler of simple queue
xTaskHandle	HPTSender_Handler;	//handler of Sender task high priority task
xTaskHandle MPTSender_Handler;	//handler of Sender task medium priority task
xTaskHandle Recv_Handler;	//handler of Receiver task
xTaskHandle Recv_Simple_Handler;	//handler of Receiver simple task

typedef struct{
	char* str;
	uint8_t u8Var;
	uint16_t u16Var;
}MyStruct_t;

uint8_t indx1 = 0, indx2 = 0;

/* USER CODE END PV */

void SystemClock_Config(void);
static void MX_GPIO_Init(void);

/* USER CODE BEGIN PFP */
/* Private function prototypes -----------------------------------------------*/
void HPT_Sender_Task(void* vParam);
void MPT_Sender_Task(void* vParam);
void Recv_Task(void* vParam);
void Recv_Task_Simple(void* vParam);
/* USER CODE END PFP */

/* USER CODE BEGIN 0 */

void HAL_GPIO_EXTI_Callback(uint16_t GPIO_Pin)
{
	if(GPIO_Pin == GPIO_PIN_0)
	{
		uint8_t dataSend = 69;
		//HAL_Delay(30);
		BaseType_t xHigherPriorityTaskWoken = pdFALSE;

		if(xQueueSendToFrontFromISR(Simple_Queue_Handler, &dataSend, &xHigherPriorityTaskWoken) == pdPASS)
			printf("Sent from ISR\n\n");

		portEND_SWITCHING_ISR(xHigherPriorityTaskWoken);
	}
}
/* USER CODE END 0 */

int main(void)
{

  /* MCU Configuration----------------------------------------------------------*/

  /* Reset of all peripherals, Initializes the Flash interface and the Systick. */
  HAL_Init();

  /* Configure the system clock */
  SystemClock_Config();

  /* Initialize all configured peripherals */
  MX_GPIO_Init();

  /* Create the thread(s) */
  /* definition and creation of defaultTask */

  /* USER CODE BEGIN RTOS_THREADS */
  /* add threads, ... */
	xTaskCreate(HPT_Sender_Task, "Sender_1", 128, NULL, 3, &HPTSender_Handler);
	xTaskCreate(MPT_Sender_Task, "Sender_2", 128, NULL, 2, &MPTSender_Handler);
	xTaskCreate(Recv_Task, "Rceiver", 128, NULL, 1, &Recv_Handler);
	xTaskCreate(Recv_Task_Simple, "Rceiver Simple", 128, NULL, 1, &Recv_Simple_Handler);
  /* USER CODE END RTOS_THREADS */

  /* USER CODE BEGIN RTOS_QUEUES */
  /* add queues, ... */
	Struct_Queue_Handler = xQueueCreate(2, sizeof(MyStruct_t));
	if(Struct_Queue_Handler == 0) //create queue fail
		printf("Create Struct Queue Fail!!!\n");
	else printf("Create Struct Queue successfully!!!\n");

	Simple_Queue_Handler = xQueueCreate(2, sizeof(uint8_t));
	if(Simple_Queue_Handler == 0) //create queue fail
		printf("Create Simple Queue Fail!!!\n");
	else printf("Create Simple Queue successfully!!!\n");
  /* USER CODE END RTOS_QUEUES */

  /* Start scheduler */
  osKernelStart();

  /* We should never get here as control is now taken by the scheduler */

  /* Infinite loop */
  while (1)
  {

  }

}

/** System Clock Configuration
*/
void SystemClock_Config(void)
{

  RCC_OscInitTypeDef RCC_OscInitStruct;
  RCC_ClkInitTypeDef RCC_ClkInitStruct;

  __HAL_RCC_PWR_CLK_ENABLE();

  __HAL_PWR_VOLTAGESCALING_CONFIG(PWR_REGULATOR_VOLTAGE_SCALE1);

  RCC_OscInitStruct.OscillatorType = RCC_OSCILLATORTYPE_HSE;
  RCC_OscInitStruct.HSEState = RCC_HSE_ON;
  RCC_OscInitStruct.PLL.PLLState = RCC_PLL_ON;
  RCC_OscInitStruct.PLL.PLLSource = RCC_PLLSOURCE_HSE;
  RCC_OscInitStruct.PLL.PLLM = 4;
  RCC_OscInitStruct.PLL.PLLN = 168;
  RCC_OscInitStruct.PLL.PLLP = RCC_PLLP_DIV2;
  RCC_OscInitStruct.PLL.PLLQ = 4;
  HAL_RCC_OscConfig(&RCC_OscInitStruct);

  RCC_ClkInitStruct.ClockType = RCC_CLOCKTYPE_HCLK|RCC_CLOCKTYPE_SYSCLK
                              |RCC_CLOCKTYPE_PCLK1|RCC_CLOCKTYPE_PCLK2;
  RCC_ClkInitStruct.SYSCLKSource = RCC_SYSCLKSOURCE_PLLCLK;
  RCC_ClkInitStruct.AHBCLKDivider = RCC_SYSCLK_DIV1;
  RCC_ClkInitStruct.APB1CLKDivider = RCC_HCLK_DIV4;
  RCC_ClkInitStruct.APB2CLKDivider = RCC_HCLK_DIV2;
  HAL_RCC_ClockConfig(&RCC_ClkInitStruct, FLASH_LATENCY_5);

  HAL_SYSTICK_Config(HAL_RCC_GetHCLKFreq()/1000);

  HAL_SYSTICK_CLKSourceConfig(SYSTICK_CLKSOURCE_HCLK);

  /* SysTick_IRQn interrupt configuration */
  HAL_NVIC_SetPriority(SysTick_IRQn, 15, 0);
}

/** Configure pins as
        * Analog
        * Input
        * Output
        * EVENT_OUT
        * EXTI
*/
void MX_GPIO_Init(void)
{

  GPIO_InitTypeDef GPIO_InitStruct;

  /* GPIO Ports Clock Enable */
  __HAL_RCC_GPIOH_CLK_ENABLE();
  __HAL_RCC_GPIOA_CLK_ENABLE();

  /*Configure GPIO pin : PA0 */
  GPIO_InitStruct.Pin = GPIO_PIN_0;
  GPIO_InitStruct.Mode = GPIO_MODE_IT_RISING;
  GPIO_InitStruct.Pull = GPIO_NOPULL;
  HAL_GPIO_Init(GPIOA, &GPIO_InitStruct);

  /* EXTI interrupt init*/
  HAL_NVIC_SetPriority(EXTI0_IRQn, 6, 0);
  HAL_NVIC_EnableIRQ(EXTI0_IRQn);

}

/* USER CODE BEGIN 4 */
void HPT_Sender_Task(void* vParam)
{
	MyStruct_t *ptrToSend;
	uint32_t timeDelay = pdMS_TO_TICKS(2000);

	while(1)
	{
		printf("Enter HPT TASK, ready to send to queue\n");
		/*aloocate memory to the ptr*/
		ptrToSend = pvPortMalloc(sizeof(MyStruct_t));

		/*load data to memory*/
		ptrToSend->u8Var = indx1 + 1;
		ptrToSend->u16Var = 1000*indx1 + 1;
		ptrToSend->str = "DATA FROM HPT";

		/*send to queue*/
		if(xQueueSend(Struct_Queue_Handler, &ptrToSend, portMAX_DELAY) == pdPASS)
		{
			printf("HPT sent data to Queue, leave HPT Task\n\n");
		}
		indx1 ++;
		vTaskDelay(timeDelay);
	}
}
void MPT_Sender_Task(void* vParam)
{
	MyStruct_t *ptrToSend;
	uint32_t timeDelay = pdMS_TO_TICKS(2000);

	while(1)
	{
		printf("Enter MPT TASK, ready to send to queue\n");
		/*aloocate memory to the ptr*/
		ptrToSend = pvPortMalloc(sizeof(MyStruct_t));

		/*load data to memory*/
		ptrToSend->u8Var = indx2 + 2;
		ptrToSend->u16Var = 2000*indx2 + 2;
		ptrToSend->str = "DATA FROM MPT";

		/*send to queue*/
		if(xQueueSend(Struct_Queue_Handler, &ptrToSend, portMAX_DELAY) == pdPASS)
		{
			printf("MPT sent data to Queue, leave MPT Task\n\n");
		}
		indx2 ++;
		vTaskDelay(timeDelay);
	}
}
void Recv_Task(void* vParam)
{
	MyStruct_t *ptrToRecv;
	uint32_t timeDelay = pdMS_TO_TICKS(3500);

	while(1)
	{
		printf("Enter Receiver Task, ready to receive\n");

		/*Recive from Queue*/
		if(xQueueReceive(Struct_Queue_Handler, &ptrToRecv, portMAX_DELAY) == pdPASS)
		{
			printf("RECEIVED FROM QUEUE:\n  U8Value = %d, U16Value = %d\n  String = %s\n\n",
				ptrToRecv->u8Var, ptrToRecv->u16Var, ptrToRecv->str);
		}
		vPortFree(ptrToRecv);
		vTaskDelay(timeDelay);
	}
}
void Recv_Task_Simple(void* vParam)
{
	uint8_t recvData;
	uint32_t timeDelay = pdMS_TO_TICKS(500);
	while(1)
	{
		if(xQueueReceive(Simple_Queue_Handler, &recvData, portMAX_DELAY) == pdPASS)
		{
			printf("Recv DATA from Simple Queue = %d\n", recvData);
		}
		vTaskDelay(timeDelay);
	}
}

/* USER CODE END 4 */

/* StartDefaultTask function */
//void StartDefaultTask(void const * argument)
//{

//  /* USER CODE BEGIN 5 */
////  /* Infinite loop */
////  for(;;)
////  {
////    osDelay(1);
////  }
//  /* USER CODE END 5 */
//}

/************************ (C) COPYRIGHT STMicroelectronics *****END OF FILE****/
